## app/boards/arm/tinyqaz/Kconfig.defconfig
```kconfig
# Tinyqaz board configuration

# Copyright (c) 2016 Open-RnD Sp. z o.o.
# SPDX-License-Identifier: Apache-2.0

if BOARD_TINYQAZ

config ZMK_KEYBOARD_NAME
	default "Tinyqaz"

config ZMK_USB
	default y

config ZMK_KSCAN_DIRECT_POLLING
	default y

endif # BOARD_TINYQAZ
```
